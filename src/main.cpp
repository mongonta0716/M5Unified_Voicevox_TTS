/*
  VOICEVOX Test example.
  Streaming HTTP source for voicevox

  This source is StreamMP3FromHTTP(https://github.com/earlephilhower/ESP8266Audio) 
  modified for WAV playback generated by Voicevox(https://voicevox.hiroshiba.jp/)

  Copyright (C) 2022 Takao Akaki 

  This program is free software: you can redistribute it and/or modify
  it under the terms of the GNU General Public License as published by
  the Free Software Foundation, either version 3 of the License, or
  (at your option) any later version.

  This program is distributed in the hope that it will be useful,
  but WITHOUT ANY WARRANTY; without even the implied warranty of
  MERCHANTABILITY or FITNESS FOR A PARTICULAR PURPOSE.  See the
  GNU General Public License for more details.

  You should have received a copy of the GNU General Public License
  along with this program.  If not, see <http://www.gnu.org/licenses/>.
*/

#include <Arduino.h>
#include <M5Unified.h>
#ifdef ESP32
    #include <WiFi.h>
#else
    #include <ESP8266WiFi.h>
#endif
#include "AudioFileSourceHTTPStreamVOICEVOX.h"
#include "AudioFileSourceBuffer.h"
#include "AudioGeneratorWAV.h"
#include "AudioOutputM5Speaker.hpp"

// To run, set your ESP8266 build to 160MHz, update the SSID info, and upload.

// Enter your WiFi setup here:
#ifndef STASSID
#define STASSID "YOUR_SSID"
#define STAPSK  "YOUR_PASSWORD"
#endif

const char* ssid = STASSID;
const char* password = STAPSK;

// Voicevoxを起動しているPCのIPアドレスとポート番号を設定します。
const char *URL="http://192.168.0.222:50021";

// Voicevoxの話者番号を指定します。
const char* SPEAKER_NO = "1";


static constexpr uint8_t m5spk_virtual_channel = 0;

AudioGeneratorWAV *wav;
AudioFileSourceHTTPStreamVOICEVOX *file;
AudioFileSourceBuffer *buff;
AudioOutputM5Speaker out(&M5.Speaker, m5spk_virtual_channel);

// Called when a metadata event occurs (i.e. an ID3 tag, an ICY block, etc.
void MDCallback(void *cbData, const char *type, bool isUnicode, const char *string)
{
  const char *ptr = reinterpret_cast<const char *>(cbData);
  (void) isUnicode; // Punt this ball for now
  // Note that the type and string may be in PROGMEM, so copy them to RAM for printf
  char s1[32], s2[64];
  strncpy_P(s1, type, sizeof(s1));
  s1[sizeof(s1)-1]=0;
  strncpy_P(s2, string, sizeof(s2));
  s2[sizeof(s2)-1]=0;
  Serial.printf("METADATA(%s) '%s' = '%s'\n", ptr, s1, s2);
  Serial.flush();
}

// Called when there's a warning or error (like a buffer underflow or decode hiccup)
void StatusCallback(void *cbData, int code, const char *string)
{
  const char *ptr = reinterpret_cast<const char *>(cbData);
  // Note that the string may be in PROGMEM, so copy it to RAM for printf
  char s1[64];
  strncpy_P(s1, string, sizeof(s1));
  s1[sizeof(s1)-1]=0;
  Serial.printf("STATUS(%s) '%d' = '%s'\n", ptr, code, s1);
  Serial.flush();
}


void setup()
{
  auto cfg = M5.config();
  M5.begin(cfg);
  auto spk_cfg = M5.Speaker.config();
  spk_cfg.sample_rate = 96000;
  spk_cfg.task_pinned_core = APP_CPU_NUM;
  M5.Speaker.config(spk_cfg);

  M5.Speaker.begin();
  M5.Speaker.setVolume(200);
  delay(1000);
  Serial.println("Connecting to WiFi");
  M5.Display.init();
  M5.Display.setTextSize(3);
  M5.Display.println("Voicevox Test");

  WiFi.disconnect();
  WiFi.softAPdisconnect(true);
  WiFi.mode(WIFI_STA);
  
  WiFi.begin(ssid, password);

  // Try forever
  while (WiFi.status() != WL_CONNECTED) {
    Serial.println("...Connecting to WiFi");
    delay(1000);
  }
  Serial.println("Connected");

  audioLogger = &Serial;
  file = new AudioFileSourceHTTPStreamVOICEVOX();
  file->setSpeakerNo(SPEAKER_NO);
  file->setText("私はえむごすたっくです。");
  file->open(URL);
  file->RegisterMetadataCB(MDCallback, (void*)"HTTP");
  buff = new AudioFileSourceBuffer(file, 2048);
  buff->RegisterStatusCB(StatusCallback, (void*)"buffer");
  wav = new AudioGeneratorWAV();
  wav->RegisterStatusCB(StatusCallback, (void*)"wav");
  wav->begin(buff, &out);
}

void speechText(String speech_text) {
  file = new AudioFileSourceHTTPStreamVOICEVOX();
  file->setSpeakerNo(SPEAKER_NO);
  file->setText(speech_text);
  file->open(URL);
  file->RegisterMetadataCB(MDCallback, (void*)"HTTP");
  buff = new AudioFileSourceBuffer(file, 2048);
  buff->RegisterStatusCB(StatusCallback, (void*)"buffer");
//  out = new AudioOutputI2S(0, 0);
//  out->SetPinout(12, 0, 2);
//  out->SetGain(2.0);
  wav = new AudioGeneratorWAV();
  wav->RegisterStatusCB(StatusCallback, (void*)"wav");
  wav->begin(buff, &out);
}


void loop()
{

  M5.update();
  if (M5.BtnA.wasPressed()) {
    speechText("ボタンAを押しましたね？");
  }
  if (M5.BtnB.wasPressed()) {
    speechText("ボタンBを押しましたね？");
  }
  if (M5.BtnC.wasPressed()) {
    speechText("ボタンCを押しましたね？");
  }
  static int lastms = 0;

  if (wav->isRunning()) {
    if (millis()-lastms > 1000) {
      lastms = millis();
      Serial.printf("Running for %d ms...\n", lastms);
      Serial.flush();
     }
    if (!wav->loop()) {
      Serial.printf("WAV done\n");
      wav->stop();
      delay(100);
      // デストラクタを実行しないと同時実行時に不具合が起きる場合あり。
      wav->~AudioGeneratorWAV();
//      out->~AudioOutputI2S();
      buff->~AudioFileSourceBuffer();
      file->~AudioFileSourceHTTPStreamVOICEVOX();
    }
  }
}

